## conf/layer.conf
```bitbake
# We have conf and classes directory, add to BBPATH
BBPATH := "${BBPATH}:${LAYERDIR}"

# We have a packages directory, add to BBFILES
BBFILES += "${LAYERDIR}/recipes-*/*/*.bb \
            ${LAYERDIR}/recipes-*/*/*.bbappend"

BBFILE_COLLECTIONS += "vj"
BBFILE_PATTERN_vj := "^${LAYERDIR}/"
BBFILE_PRIORITY_vj = "10"
LAYERSERIES_COMPAT_vj = "rocko sumo"
```
